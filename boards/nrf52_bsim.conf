## dts/bindings/slimevr,icm45686-emul.yaml
```yaml
description: ICM-45686 register emulator for nrf52_bsim (tools/bsim)
compatible: "slimevr,icm45686-emul"
include: spi-device.yaml
```

## dts/bindings/slimevr,qmc6309-emul.yaml
```yaml
description: QMC6309 register emulator for nrf52_bsim (tools/bsim)
compatible: "slimevr,qmc6309-emul"
include: i2c-device.yaml
```
